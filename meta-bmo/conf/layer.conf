## meta-bmo/conf/layer.conf
```bitbake
# We have a conf and classes directory, add to BBPATH
BBPATH .= ":${LAYERDIR}"

# We have recipes-* directories, add to BBFILES
BBFILES += "${LAYERDIR}/recipes-*/*/*.bb \
            ${LAYERDIR}/recipes-*/*/*.bbappend"

BBFILE_COLLECTIONS += "meta-bmo"
BBFILE_PATTERN_meta-bmo = "^${LAYERDIR}/"
BBFILE_PRIORITY_meta-bmo = "6"

LAYERDEPENDS_meta-bmo = "core"
LAYERSERIES_COMPAT_meta-bmo = "scarthgap"
```

## meta-hey_man/conf/layer.conf
```bitbake
# We have a conf and classes directory, add to BBPATH
BBPATH .= ":${LAYERDIR}"

# We have recipes-* directories, add to BBFILES
BBFILES += "${LAYERDIR}/recipes-*/*/*.bb \
            ${LAYERDIR}/recipes-*/*/*.bbappend"

BBFILE_COLLECTIONS += "meta-hey_man"
BBFILE_PATTERN_meta-hey_man = "^${LAYERDIR}/"
BBFILE_PRIORITY_meta-hey_man = "6"

LAYERDEPENDS_meta-hey_man = "core"
LAYERSERIES_COMPAT_meta-hey_man = "scarthgap"
```
